#ifndef _ASCIIMATRIX_H_
#define _ASCIIMATRIX_H_

#include <cstdint>

#ifdef ARDUINO
#include <avr/pgmspace.h>
#endif

#include "MatrixLED.h"

// access as "_fonts['a' - _ASCII_OFFSET]"
static const int _ASCII_OFFSET = 0x20;

/**
 * @brief Get a row of indicated ascii char.
 * @param c [in] Char to get row.
 * @param row [in] Row number between [0, 6].
 * @retval uint8_t Row data on success.
 * @retval uint8_t N/A row data on illegal c.
 * @retval 0 on illegal row.
*/
static inline uint8_t getASCIIRow(char c, uint8_t row);

/**
 * @brief Write single ascii char to single matrixLED.
 * @param matrixLED [in] Pointer of MatrixLED.
 * @param c [in] Char to write.
 * @param offset_from_left [in] Offset size from left end.
*/
void writeAsciiToMatrixLED(MatrixLED &matrixLED, char c, int16_t offset_from_left);

/**
 * @brief Write ascii string to multiple matrixLED.
 * @param matrixLEDs [in] Reference of MatrixLED-Array.
 * @param ledlen [in] Length of MatrixLED-Array.
 * @param string [in] Char-Array to write.
 * @param offset_from_left [in] Offset size from left end.
 * @retval Number of used matrix panels (from left).
*/
size_t writeAsciisToMatrixLEDs(MatrixLED *matrixLEDs, uint8_t ledlen, const char *string, int16_t offset_from_left);


#ifdef ARDUINO
static const uint8_t _ASCII_FONTS[95][7] PROGMEM
#else
static const uint8_t _ASCII_FONTS[95][7]
#endif

= {
  {0x00, 0x00, 0x00, 0x00, 0x00, 0x00, 0x00},  // 0x20, Space
  {0x04, 0x04, 0x04, 0x04, 0x04, 0x00, 0x04},  // 0x21, !
  {0x09, 0x09, 0x12, 0x00, 0x00, 0x00, 0x00},  // 0x22, "
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  {0x08, 0x15, 0x02, 0x00, 0x00, 0x00, 0x00}   // 0x7e, ~
};

// Send this when fail gettng ascii char (Not Available Code);
static const uint8_t _NA_CHAR[7]
= {
  0b00011001,
  0b00010101,
  0b00010011,
  0b00000000,
  0b00000100,
  0b00001110,
  0b00010001,
};

static const uint8_t _HT[7]
= {
  0b00001000,
  0b00000100,
  0b00000010,
  0b00000100,
  0b00001110,
  0b00000100,
  0b00000111,
};

static const uint8_t _CR[7]
= {
  0b00001000,
  0b00000100,
  0b00000010,
  0b00000000,
  0b00001011,
  0b00001100,
  0b00001000,
};

static const uint8_t _LF[7]
= {
  0b00001000,
  0b00000100,
  0b00000010,
  0b00000000,
  0b00001110,
  0b00001001,
  0b00001001,
};

static const uint8_t _EOS[7]
= {
  0b00001000,
  0b00000100,
  0b00000010,
  0b00000000,
  0b00000110,
  0b00001001,
  0b00000110,
};

static inline uint8_t getASCIIRow(char c, uint8_t row)
{
  if (c == '\t')
    return *(_HT + row);
  if (c == '\r')
    return *(_CR + row);
  if (c == '\n')
    return *(_LF + row);
  if (c == '\0')
    return *(_EOS + row);

  if (c < _ASCII_OFFSET || 94 + _ASCII_OFFSET < c)  // Out of Ascii Code Table
    return *(_NA_CHAR + row);

  if (7 < row)
    return 0x00;

  #ifdef ARDUINO  // using EEPROM
  return pgm_read_byte(*(_ASCII_FONTS + c - _ASCII_OFFSET) + row);
  #else
  return *(*(_ASCII_FONTS + c - _ASCII_OFFSET) + row);
  #endif
}

#endif  /* _ASCIIMATRIX_H_ */
